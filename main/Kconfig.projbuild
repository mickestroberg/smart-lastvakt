## main/Kconfig.projbuild
```kconfig
menu "Example Configuration"

    menu "Smart lastvakt"
        config LASTVAKT_MAIN_FUSE_A
            int "Main fuse per phase (A)"
            default 25
            range 10 63
            help
                Used to convert current into phase load percentage.

        config LASTVAKT_ORANGE_PERCENT
            int "Start orange zone at load (%)"
            default 40
            range 10 100

        config LASTVAKT_RED_PERCENT
            int "Start red zone and open phase view above load (%)"
            default 70
            range 10 100

        config LASTVAKT_ALERT_HOLD_SECONDS
            int "Keep phase view visible after alert (seconds)"
            default 8
            range 1 120

        config LASTVAKT_MICROWAVE_L1_LIMIT_A
            int "Automatic microwave cutoff above L1 current (A)"
            default 20
            range 10 63
            help
                The Shelly output is turned off when the microwave is drawing power
                and fresh Tibber data reports L1 above this limit. The guard never
                turns the output on.

        config LASTVAKT_MICROWAVE_ACTIVE_POWER_W
            int "Microwave active power threshold (W)"
            default 500
            range 20 2500
            help
                The automatic cutoff is armed only while Shelly reports at least
                this much power, avoiding trips caused by standby or cooling loads.

        config LASTVAKT_MICROWAVE_MAX_TIBBER_AGE_SECONDS
            int "Maximum Tibber sample age for microwave cutoff (seconds)"
            default 5
            range 1 30
            help
                Missing, previous-session or older phase values are never used for
                relay decisions.

        config LASTVAKT_TIBBER_PRICE_SHADOW
            bool "Enable read-only Tibber quarter-price shadow source"
            default n
            help
                Downloads and ranks today's and, when published, tomorrow's
                quarter-hourly Tibber total prices in RAM. A read-only page shows
                the current hypothetical price limit and the coming 24 hours'
                half-limit quarters. Fully blocked quarters remain an optional
                simulation setting and default to zero. The source has no
                connection to any physical output. Requires a previously saved
                explicit Tibber home ID and an NTP-synchronized clock. No schedule
                is persisted.

        config LASTVAKT_TIBBER_PRICE_SHADOW_OFF_QUARTERS
            int "Shadow only: highest-price quarters marked fully blocked"
            depends on LASTVAKT_TIBBER_PRICE_SHADOW
            default 0
            range 0 100
            help
                Future simulation option only. Safe version 1 uses zero because
                price control must not remove all heater power or cycle its main
                supply. There is no physical output from this shadow source.

        config LASTVAKT_TIBBER_PRICE_SHADOW_HALF_QUARTERS
            int "Shadow: highest remaining quarters marked half limited"
            depends on LASTVAKT_TIBBER_PRICE_SHADOW
            default 15
            range 0 100
            help
                Safe version 1 marks the day's 15 most expensive quarters as
                limited to at most half power. All other quarters have no price
                restriction. This remains read-only shadow behavior.

    endmenu

    menu "Display"
        config EXAMPLE_LCD_RGB_BOUNCE_BUFFER_HEIGHT
            int "RGB Bounce buffer height"
            default 10
            help
                Height of bounce buffer. The width of the buffer is the same as that of the LCD.

        config EXAMPLE_LVGL_PORT_TASK_MAX_DELAY_MS
            int "LVGL timer task maximum delay (ms)"
            default 500
            range 2 2000  # Example range, adjust as needed
            help
            The maximum delay of the LVGL timer task, in milliseconds.

        config EXAMPLE_LVGL_PORT_TASK_MIN_DELAY_MS
            int "LVGL timer task minimum delay (ms)"
            default 10
            range 1 100  # Example range, adjust as needed
            help
            The minimum delay of the LVGL timer task, in milliseconds.

        config EXAMPLE_LVGL_PORT_TASK_PRIORITY
            int "LVGL task priority"
            default 2
            help
                The Board Support Package will create a task that will periodically handle LVGL operation in lv_timer_handler().

        config EXAMPLE_LVGL_PORT_TASK_STACK_SIZE_KB
            int "LVGL task stack size (KB)"
            default 6
            help
                Size(KB) of LVGL task stack.

        config EXAMPLE_LVGL_PORT_TASK_CORE
            int "LVGL timer task core"
            default -1
            range -1 1
            help
            The core of the LVGL timer task.
            Set to -1 to not specify the core.
            Set to 1 only if the SoCs support dual-core, otherwise set to -1 or 0.

        config EXAMPLE_LVGL_PORT_TICK
            int "LVGL tick period"
            default 2
            range 1 100
            help
                Period of LVGL tick timer.

        config EXAMPLE_LVGL_PORT_AVOID_TEAR_ENABLE
            bool "Avoid tearing effect"
            default "n"
            help
                Avoid tearing effect through LVGL buffer mode and double frame buffers of RGB LCD. This feature is only available for RGB LCD.

        choice
            depends on EXAMPLE_LVGL_PORT_AVOID_TEAR_ENABLE
            prompt "Select Avoid Tearing Mode"
            default EXAMPLE_LVGL_PORT_AVOID_TEAR_MODE_3
            config EXAMPLE_LVGL_PORT_AVOID_TEAR_MODE_1
                bool "Mode1: LCD double-buffer & LVGL full-refresh"
            config EXAMPLE_LVGL_PORT_AVOID_TEAR_MODE_2
                bool "Mode2: LCD triple-buffer & LVGL full-refresh"
            config EXAMPLE_LVGL_PORT_AVOID_TEAR_MODE_3
                bool "Mode3: LCD double-buffer & LVGL direct-mode"
            help
                The current tearing prevention mode supports both full refresh mode and direct mode. Tearing prevention mode may consume more PSRAM space
        endchoice

        config EXAMPLE_LVGL_PORT_AVOID_TEAR_MODE
            depends on EXAMPLE_LVGL_PORT_AVOID_TEAR_ENABLE
            int
            default 1 if EXAMPLE_LVGL_PORT_AVOID_TEAR_MODE_1
            default 2 if EXAMPLE_LVGL_PORT_AVOID_TEAR_MODE_2
            default 3 if EXAMPLE_LVGL_PORT_AVOID_TEAR_MODE_3

        choice
            depends on EXAMPLE_LVGL_PORT_AVOID_TEAR_ENABLE
            prompt "Select rotation"
            default EXAMPLE_LVGL_PORT_ROTATION_0
            config EXAMPLE_LVGL_PORT_ROTATION_0
                bool "Rotation 0"
            config EXAMPLE_LVGL_PORT_ROTATION_90
                bool "Rotation 90"
            config EXAMPLE_LVGL_PORT_ROTATION_180
                bool "Rotation 180"
            config EXAMPLE_LVGL_PORT_ROTATION_270
                bool "Rotation 270"
        endchoice

        config EXAMPLE_LVGL_PORT_ROTATION_DEGREE
            int
            default 0 if EXAMPLE_LVGL_PORT_ROTATION_0
            default 90 if EXAMPLE_LVGL_PORT_ROTATION_90
            default 180 if EXAMPLE_LVGL_PORT_ROTATION_180
            default 270 if EXAMPLE_LVGL_PORT_ROTATION_270

        choice
            depends on !EXAMPLE_LVGL_PORT_AVOID_TEAR_ENABLE
            prompt "Select LVGL buffer memory capability"
            default EXAMPLE_LVGL_PORT_BUF_INTERNAL
            config EXAMPLE_LVGL_PORT_BUF_PSRAM
                bool "PSRAM memory"
            config EXAMPLE_LVGL_PORT_BUF_INTERNAL
                bool "Internal memory"
        endchoice

        config EXAMPLE_LVGL_PORT_BUF_HEIGHT
            depends on !EXAMPLE_LVGL_PORT_AVOID_TEAR_ENABLE
            int "LVGL buffer height"
            default 100
            help
                Height of LVGL buffer. The width of the buffer is the same as that of the LCD.
    endmenu
endmenu
```
